#define FND_A 2
#define FND_B 3
#define FND_C 4
#define FND_D 5
#define FND_E 6
#define FND_F 7
#define FND_G 8
#define FND_DP 9

int seg[]={2,3,4,5,6,7,8,9}; // 배열로 D2~D9까지 세그먼트 연결


byte digits[16][8]={ // 0~9까지 숫자에 대한 LED 값

{ 1,1,1,1,1,1,0,0 }, // 0

{ 0,1,1,0,0,0,0,0 }, // 1  
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{ 1,0,0,0,1,1,1,1 },  // 15,F
};

void setup(){

 for (int i = 0; i < 8; i++){ // for 문을 사용해 핀 2~9까지 8개의 핀모드 출력으로 세팅

  pinMode(seg[i], OUTPUT);

 }

}




void loop(){

 for (int i = 0; i < 16; i++)
 {//이중 for문을 이용해 led로 숫자 출력  
  for (int j = 0; j < 8; j++)
  {
    digitalWrite(seg[j], digits[i][j]);
  }
   delay(500); // 1초간 딜레이
  }  
}